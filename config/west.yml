## config/west.yml
```yaml
manifest:
  defaults:
    revision: main
  remotes:
    - name: zmkfirmware
      url-base: https://github.com/zmkfirmware
  projects:
    - name: zmk
      remote: zmkfirmware
      revision: main
      import: app/west.yml
    - name: zmk-rgbled-widget
      url: https://github.com/caksoylar/zmk-rgbled-widget
      revision: main
    - name: zmk-usb-rgb-idle-bypass
      url: https://github.com/tfranz25/zmk-usb-rgb-idle-bypass
      revision: main
    - name: zmk-rgb-plus
      url: https://github.com/tfranz25/zmk-rgb-plus
      revision: main
  self:
    path: config
```
